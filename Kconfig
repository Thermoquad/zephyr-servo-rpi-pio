## Kconfig
```kconfig
# Copyright (c) 2026 Thermoquad
# SPDX-License-Identifier: Apache-2.0

rsource "drivers/pwm/Kconfig"
```

## drivers/pwm/Kconfig
```kconfig
# Copyright (c) 2026 Thermoquad
# SPDX-License-Identifier: Apache-2.0

config PWM_SERVO_RPI_PICO_PIO
	bool "PIO-based servo PWM driver for Raspberry Pi Pico"
	default y
	depends on DT_HAS_RASPBERRYPI_PICO_PWM_SERVO_PIO_ENABLED
	depends on PIO_RPI_PICO
	select PWM
	help
	  Enable the PIO-based servo PWM driver for RP2040/RP2350.
	  Uses one PIO state machine per servo channel with 1µs resolution.
	  Supports standard 50Hz servos and high-frequency digital servos.
```

## dts/bindings/pwm/raspberrypi,pico-pwm-servo-pio.yaml
```yaml
# Copyright (c) 2026 Thermoquad
# SPDX-License-Identifier: Apache-2.0

description: |
  PIO-based servo PWM driver for Raspberry Pi Pico (RP2040/RP2350).
  Uses one PIO state machine to generate a servo-compatible PWM signal
  with 1µs resolution. Supports standard (50Hz) and high-frequency
  digital servos (up to 333Hz).

  The node must be a child of a PIO node (&pio0, &pio1, or &pio2).

  Example:
    &pio1 {
      status = "okay";

      servo_pio: servo-pwm {
        compatible = "raspberrypi,pico-pwm-servo-pio";
        gpios = <&gpio0 2 GPIO_ACTIVE_HIGH>;
        #pwm-cells = <3>;
        status = "okay";
      };
    };

compatible: "raspberrypi,pico-pwm-servo-pio"

include: [pwm-controller.yaml]

properties:
  gpios:
    type: phandle-array
    required: true
    description: |
      GPIO pin to use for the servo PWM output. Only the pin number is
      used — flags are ignored (PIO controls the pin directly).

  "#pwm-cells":
    const: 3

pwm-cells:
  - channel
  - period
  - flags
```
